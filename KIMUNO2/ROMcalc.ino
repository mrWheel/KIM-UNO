/*
*
*    
*   Coding style
*       - One True Brace Style formatting/indenting.
*       - Linux brackets, add brackets to all conditionals.
*/
#include "Config.h"

    //void processCalcKey(uint8_t curkey) {};
    //uint8_t enterflt(uint8_t reg) {};
    //uint8_t showflt(uint8_t reg) {};
    //uint8_t enteroperation(void) {};

#if _INCL_CALCULATOR == TRUE

    #define WREG_OFFSET 0x0360

    #include <stdint.h>
    #if _TARGET == PERSONAL_COMPUTER
        unsigned char calcROM[8164] = {
    #else
        const unsigned char calcROM[8164] PROGMEM = {
    #endif

//  0xA2, 0xFF, 0x9A, 0xD8, 0x0A, 0x0A, 0x18, 0x69, 0x11, 0xAA, 0xA9, 0x50,
    0xA2, 0xFF, 0xEA, 0xD8, 0x0A, 0x0A, 0x18, 0x69, 0x11, 0xAA, 0xA9, 0x50,
//  0x69, 0x00, 0x48, 0x8A, 0x48, 0x60, 0x20, 0xB6, 0x50, 0x00, 0x20, 0xAE,
    0x69, 0x00, 0x48, 0x8A, 0x48, 0x60, 0x20, 0xB6, 0x50, 0x60, 0x20, 0xAE,
//  0x50, 0x00, 0x20, 0x78, 0x53, 0x00, 0x20, 0x35, 0x55, 0x00, 0x20, 0xE6,
    0x50, 0x60, 0x20, 0x78, 0x53, 0x60, 0x20, 0x35, 0x55, 0x60, 0x20, 0xE6,
//  0x56, 0x00, 0x20, 0x3E, 0x66, 0x00, 0x20, 0xE2, 0x66, 0x00, 0x20, 0x2B,
    0x56, 0x60, 0x20, 0x3E, 0x66, 0x60, 0x20, 0xE2, 0x66, 0x60, 0x20, 0x2B,
//  0x67, 0x00, 0x20, 0x54, 0x66, 0x00, 0x20, 0x66, 0x66, 0x00, 0x20, 0x0A,
    0x67, 0x60, 0x20, 0x54, 0x66, 0x60, 0x20, 0x66, 0x66, 0x60, 0x20, 0x0A,
//  0x59, 0x00, 0x20, 0x33, 0x59, 0x00, 0x20, 0x4C, 0x59, 0x00, 0x20, 0x91,
    0x59, 0x60, 0x20, 0x33, 0x59, 0x60, 0x20, 0x4C, 0x59, 0x60, 0x20, 0x91,
//  0x59, 0x00, 0x20, 0xB5, 0x58, 0x00, 0x20, 0x8C, 0x59, 0x00, 0x20, 0x96,
    0x59, 0x60, 0x20, 0xB5, 0x58, 0x60, 0x20, 0x8C, 0x59, 0x60, 0x20, 0x96,
//  0x5B, 0x00, 0x20, 0x7D, 0x5B, 0x00, 0x20, 0x2F, 0x5C, 0x00, 0x20, 0x4E,
    0x5B, 0x60, 0x20, 0x7D, 0x5B, 0x60, 0x20, 0x2F, 0x5C, 0x60, 0x20, 0x4E,
//  0x5E, 0x00, 0x20, 0x66, 0x5E, 0x00, 0x20, 0x7E, 0x5E, 0x00, 0x20, 0x96,
    0x5E, 0x60, 0x20, 0x66, 0x5E, 0x60, 0x20, 0x7E, 0x5E, 0x60, 0x20, 0x96,
//  0x5E, 0x00, 0x20, 0x35, 0x61, 0x00, 0x20, 0x13, 0x63, 0x00, 0x20, 0x54,
    0x5E, 0x60, 0x20, 0x35, 0x61, 0x60, 0x20, 0x13, 0x63, 0x60, 0x20, 0x54,
//  0x63, 0x00, 0x20, 0x8D, 0x63, 0x00, 0x20, 0x0D, 0x64, 0x00, 0x20, 0x25,
    0x63, 0x60, 0x20, 0x8D, 0x63, 0x60, 0x20, 0x0D, 0x64, 0x60, 0x20, 0x25,
//  0x64, 0x00, 0x20, 0x3D, 0x64, 0x00, 0x20, 0x55, 0x64, 0x00, 0x20, 0xAE,
    0x64, 0x60, 0x20, 0x3D, 0x64, 0x60, 0x20, 0x55, 0x64, 0x60, 0x20, 0xAE,
//  0x64, 0x00, 0x20, 0x07, 0x65, 0x00, 0x20, 0x74, 0x65, 0x00, 0x20, 0x95,
    0x64, 0x60, 0x20, 0x07, 0x65, 0x60, 0x20, 0x74, 0x65, 0x60, 0x20, 0x95,
//  0x65, 0x00, 0x20, 0xB6, 0x65, 0x00, 0x20, 0xD7, 0x65, 0x00, 0x20, 0xEF,
    0x65, 0x60, 0x20, 0xB6, 0x65, 0x60, 0x20, 0xD7, 0x65, 0x60, 0x20, 0xEF,
//  0x65, 0x00, 0x20, 0x07, 0x66, 0x00, 0xAD, 0x68, 0x03, 0x49, 0x80, 0x8D,
    0x65, 0x60, 0x20, 0x07, 0x66, 0x60, 0xAD, 0x68, 0x03, 0x49, 0x80, 0x8D,

    0x68, 0x03, 0xF8, 0xAD, 0x62, 0x03, 0xD0, 0x09, 0xA9, 0x68, 0xA0, 0x03,
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    0x40, 0x02, 0x20, 0x00, 0x00, 0x00, 0x00, 0x00, 0xC0, 0x01, 0x33, 0x00,
//  0x00, 0x00, 0x00, 0x00, 0xC0, 0x02, 0x20, 0x00, 0x00, 0x00, 0x00, 0x00
    0x00, 0x00, 0x00, 0x00, 0xC0, 0x02, 0x20, 0x00, 0x00, 0x00, 0x00, 0x00, 0x20, 0x00, 0x50, 0x00
};

void processCalcKey(uint8_t curkey)
{
    switch (curkey) {
    case 'C':
        enterflt((uint8_t)0);
        if (!((curkey>='C') && (curkey<='F'))) {
            break;    // if statement allows roll-through to next reg entry
        }
    case 'D':
        enterflt((uint8_t)1);
        if (!((curkey>='C') && (curkey<='F'))) {
            break;
        }
    case 'F':
        enteroperation();
        break;
    case 'E':
        enterflt((uint8_t)2);
        break;

    case   1:
        showflt(0);
        break; // AD
    case   4:
        showflt(1);
        break; // DA
    case  16:
        showflt(2);
        break; // PC
    }   // switch(cukey)

}  // processCalcKey()



extern "C" {  // the extern C is to make function accessible from within CPU.c
    uint8_t enterflt(uint8_t reg)       // result code -1 = cancel, 0 = good
    {
        uint8_t fltstr[32];                 // display string
        uint8_t decpt = 0xFF, expt = 0xFF;  // pointers to start of mantissa & exponent in string
        uint8_t mntsign = 0, expsign = 0;   // 1 means negative for mantissa/exponent
        uint8_t strpos = 0, i, j;               // strpos is position counter in string
        //uint8_t mntval = 0, expval = 0;     // parsed value of mantissa & exponent
        uint8_t carry = 0, addToExp;
        int digit;
        uint16_t offset;
        uint8_t done=0;

        // init
        offset = WREG_OFFSET + 8*reg;
        for (i=0; i<8; i++)
            #if _TARGET == PERSONAL_COMPUTER
                fltstr[i]='_';
            #else
                fltstr[i]=65;
            #endif

        // input loop ---------------------------------------------------------------
        do {
            #if _TARGET == PERSONAL_COMPUTER
                if (_kbhit()) {//}
                    curkey = _getch();
            #else
                curkey=0;
                driveCalcLEDs(fltstr, decpt);  // xxxxxx decpt may be a problem
                scanKeys();
                if (curkey!=0) {
            #endif

                if (curkey=='+') {
                    if (expt==0xFF) {           // not yet into exponent
                        mntsign = 1;
                        strpos=0;
                        #if _TARGET == PERSONAL_COMPUTER
                            fltstr[strpos++] = '-';
                        #else
                            fltstr[strpos++] = 64;
                        #endif
                    } else {                        // minus sign relates to exponent
                        expsign = 1;
                        strpos=expt;
                        #if _TARGET == PERSONAL_COMPUTER
                            fltstr[strpos++] = '-';
                        #else
                            fltstr[strpos++] = 64;
                        #endif
                    }
                }
                if ((curkey>='0') && (curkey<='9')) {
                    // temp protection against entering 0.025, which breaks this code.
                    // temp fix: do not allow entering a 0 after 0.
                    if ((curkey=='0') && (decpt==(strpos-1)) && (fltstr[strpos-1]=='0')) {
                        // do nothing, that's the temp fix
                    } else
                        // end of temp bug fix
                    {
                        fltstr[strpos++] = curkey;
                    }
                }
                if (curkey=='B') {
                    expt = strpos;
                    #if _TARGET == PERSONAL_COMPUTER
                        fltstr[strpos++] = 'E';
                    #else
                        fltstr[strpos++] = 62;
                    #endif
                }
                if (curkey=='A') {
                    decpt = strpos-1;
                }

                #if _TARGET == PERSONAL_COMPUTER
                    fltstr[strpos] = 65;
                #else
                    fltstr[strpos]=0x00;        // terminate into nice string
                #endif
            }
        }
        while ((strpos<8) && (curkey!=7) && (curkey!=19) && (1!=(curkey>='C') && (curkey<='F')));

        if (curkey==19) {
            return(-1);    // cancel
        }

        // parse into 8 byte fltpt65 format -----------------------------------------------------------------
        // Ugly, horrible code. But running out of Arduino memory means C library calls must be avoided.

        if (expt==0xFF) {   // if no E was entered, let it start at end of string and be 0 length
            expt = strpos;
        }
        if (decpt==0xFF) {  // if no dec pt was entered, put it at end of mantissa, just before the E
            decpt = expt-1;
        }
        addToExp = decpt - mntsign; // normalise mantissa: how much to add to exp to have 1.2345 format

        // Exponent 3: parse and adjust exponent value to get normalised 1.23 format using addToExp
        if ((strpos-1)>expt) {  // user at least entered 1 exp digit
            digit = (expsign==1?-1:1) * ((int) fltstr[strpos-1]-48) + (int) addToExp;    //expsign*-1: deal with negative exps
        } else {
            digit = (int) addToExp;    // user entered number without exp. So exp is 0.
        }
        if (digit<0) {
            digit = -(digit);    // do not want to use abs() function-arduino out of memory space :)
        }
        RAM[offset+1] = (digit<=9?digit:digit-10);  // store adjusted exp digit
        addToExp = (digit<=9?0:1);                  // simple carry mechanism: add could overflow to 2nd sigit

        // Exponent 2: same thing.
        if ((strpos-2)>expt) {  // user entered a second exp digit
            digit = (expsign==1?-1:1) * ((int) fltstr[strpos-2]-48) + (int) addToExp;    //expsign*-1: deal with negative exps
        } else {
            digit = (int) addToExp;    // user entered number without exp. So exp is 0.
        }
        if (digit<0) {
            digit = -(digit);    // do not want to use abs() function-arduino out of memory space :)
        }
        RAM[offset+1] |= (digit<=9?digit:digit-10)<<4;  // store adjusted exp digit in upper nibble
        addToExp = (digit<=9?0:1);                  // simple carry mechanism: add could overflow to 2nd sigit

        // Exponent 1: same thing.
        if ((strpos-3)>expt) {  // user entered a second exp digit
            digit = ((int) fltstr[strpos-3]-48) + (int) addToExp;    // there is no carry or add to exp in digit 3
        } else {
            digit = (int) addToExp;    // user entered number without exp. So exp is 0.
        }
        if (digit<0) {
            digit = -(digit);    // do not want to use abs() function-arduino out of memory space :)
        }
        RAM[offset+0] = (digit<=9?digit:digit-10);  // store adjusted exp digit in lower nibble

        // Sign bits
        RAM[offset+0] |= ((mntsign<<7) | (expsign<<6));
    //  printf("%u %u ", (RAM[offset+0] & 0xF0)>>4, RAM[offset+0] & 0x0F);
    //  printf("%u %u \n", (RAM[offset+1] & 0xF0)>>4, RAM[offset+1] & 0x0F);

        // print mantissa
        j = mntsign;
        for (i=0; i<12; i++) {
            if (j<expt) {
                RAM[offset+2+i] = (fltstr[j]-48)<<4;
            } else {
                RAM[offset+2+i] = 0;
            }
            j++;

            if (j<expt) {
                RAM[offset+2+i] |= (fltstr[j]-48);
            }
            j++;

         // printf("%u %u ", (RAM[offset+2+i] & 0xF0)>>4, RAM[offset+2+i] & 0x0F);
        }
     // printf("\n");
        return (curkey);  // return value, if not -1, can be used to jump to next register value entry call
    } // end function
} // end C segment

extern "C" {  // the extern C is to make function accessible from within CPU.c
    uint8_t showflt(uint8_t reg)    // returns location of decimal point in string
    {
        uint8_t fltstr[32];                 // display string
        uint8_t mntsign = 0, expsign = 0;   // 1 means negative for mantissa/exponent
        uint8_t cnt, expt, i;   // decpt,
        uint16_t offset;
        int exp, decpt;

        // init
        offset = WREG_OFFSET + 8*reg;
        for (i=0; i<8; i++) {
            fltstr[i]='_';    // no longer necessary I think
        }
        // calculate exponent
        exp = (RAM[offset+1] & 0x0F) + 10*((RAM[offset+1] & 0xF0)>>4) + 100*(RAM[offset+0] & 0x0F);
     // printf("\n\nexp = %d\n", exp);

        // determine maximum exponent value we can show as normal number without E
        mntsign = (RAM[offset+0] & 0x80)>>7;    // negative mantissa: 1
        expsign = (RAM[offset+0] & 0x40)>>6;    // negative exponent: 1
        decpt = (mntsign==0?0:1);                   // dec point is after digit0 (+ values) or digit1 (- values)

        // with pos numbers, any E between 0 and 7 can be polished away. If there's a '-', one less
        if ((exp>0) && (exp<(7 - mntsign)) && (expsign==0)) {
            // yes, we can polish E away
            decpt +=exp;
            expt = 0;
        }
//      else // negative exponent
//      {   decpt -=exp;
//          // need to ROR the string's digits or decpt gets to be negative!
//
//          expt = 0;
//      }
//  }
//  else                        // we need to show exponent, how many digits?
        {
            expt = 0;
            if (exp>0) {
                expt = 2; //1;
                fltstr[6] = (RAM[offset+1] & 0x0F) + 48;
            }
            if (exp>9) {
                expt = 3; //2;
                fltstr[5] = (uint8_t) ((RAM[offset+1] & 0xF0)>>4) + (uint8_t) 48;
            }
            if (exp>90) {
                expt = 4; //3;
                fltstr[4] = (RAM[offset+0] & 0x0F) + 48;
            }
            #if _TARGET == PERSONAL_COMPUTER
                fltstr[7-expt] = (expsign==1?64:62);
            #else
                fltstr[7-expt] = (expsign==1?'-':'E');
            #endif
        }

        // fill string with mantissa
        cnt=0;
        if (mntsign==1)
            #if _TARGET == PERSONAL_COMPUTER
                fltstr[0] = 64;
            #else
                fltstr[0]='-';
            #endif

        for (i=mntsign; i<(7-expt); i=i+2) {
            fltstr[i] = (uint8_t) ((RAM[offset + 2 + cnt ] & 0xF0)>>4) + (uint8_t) 48;
//          printf(" %c ", (uint8_t) ((RAM[offset + 2 + cnt ] & 0xF0)>>4) + (uint8_t) 48);
            if ((i+1)<(7-expt)) { // bug fix 20141007
                fltstr[i+1] = (RAM[offset + 2 + cnt ] & 0x0F) + 48;
//              printf(" %c   ", (RAM[offset + 2 + cnt ] & 0x0F) + 48);
            }
            cnt++;
        }
        fltstr[7]=0x00; // string terminator

//      printf("\n\n%s\n", fltstr);

        #if _TARGET == PERSONAL_COMPUTER
            // show number with dec point inserted
            for (i=0; i<=decpt; i++) {
                printf("%c", fltstr[i]);
            }
            printf(".");
            for (i=decpt+1; i<7; i++) {
                printf("%c", fltstr[i]);
            }
            printf("\n");
        #else
            curkey=0;
            do {
                driveCalcLEDs(fltstr, decpt);
                scanKeys();
            } while (curkey==0);
            if ((curkey<'C') || (curkey>'F')) {
                curkey=0;    // to clear any keypresses before returning to KIM
            }
        #endif

        return decpt;                       // pointers to start of mantissa & exponent in string
    } // end function
} // end C segment


extern "C" {  // the extern C is to make function accessible from within CPU.c
    uint8_t enteroperation(void)        // result code -1 = cancel, 0 = good
    {
        uint8_t fltstr[8];                  // display string
        uint8_t strpos = 4, i;              // strpos is position counter in string

        // init
        #if _TARGET == PERSONAL_COMPUTER
            for (i=0; i<8; i++) {
                fltstr[i]=' ';
            }
            fltstr[4]='_';
            fltstr[5]='_';
        #else
            for (i=0; i<8; i++) {
                fltstr[i]=66;
            }
            fltstr[4]=65;
            fltstr[5]=65;
        #endif

        // input loop ---------------------------------------------------------------
        do {
            #if _TARGET == PERSONAL_COMPUTER
                if (_kbhit()) { // } this curly brace is there so Arduino IDE does not miscount when it does { } highlighting
                    curkey = _getch();
            #else
                curkey=0;
                driveCalcLEDs(fltstr, 5);
                scanKeys();
                if (curkey!=0) {
            #endif

                if ((curkey>=48) && (curkey<=57)) {   //only allow dec digits
                    fltstr[strpos++] = curkey;
                }

                #if _TARGET == PERSONAL_COMPUTER
                    fltstr[strpos]=0x00;        // terminate into nice string
//                  printf("> %s  ms%u es%u expt%u decpt%u\r", fltstr, mntsign, expsign, expt, decpt);
                #else
                    fltstr[strpos] = 65;
                #endif
            }
        }
        while ((strpos<6) && (curkey!=7) && (curkey!=19));

        if (curkey==19) {
            return(-1);    // cancel
        }

        RAM[0x00F3]= (fltstr[4]-48)*10 + (fltstr[5]-48);  // operation to go into 6502 A register
        RAM[0x00EF] = (uint8_t) 0xE0;
        RAM[0x00F0] = (uint8_t) 0x6F;                // set PC register to fltpt65 start address (0x6FE0, not 0x5000, we need to start with a JSR and end with a BRK)
        curkey = 16;  // PC

        return(RAM[0x00F3]);
    }
} // end C segment

void driveCalcLEDs(uint8_t *numberStr, uint8_t decpt)
{
    uint8_t led, col, ledNo, currentBit, bitOn;
    uint8_t digit,i;

    // 1. initialse for driving the 6 segment LEDs
    for (led=0; led<7; led++) {
        pinMode(ledSelect7[led], OUTPUT);  // set led pins to output
        digitalWrite(ledSelect7[led], LOW); // LOW = not lit
    }
    // 2. switch column pins to output mode
    for (digit=0; digit<7; digit++) {
        for (col=0; col<segmLEDs; col++) {
            pinMode(aCols[col], OUTPUT);           // set pin to output
            currentBit = (1<<(7-col));             // isolate the current bit in loop
            bitOn = (currentBit&dig[numberStr[digit]-48])==0;
            if (col==0 && digit==decpt) { // show decimal point here?
                bitOn=0;    // 0 being light led.
            }
            digitalWrite(aCols[col], bitOn);       // set the bit
        }
        digitalWrite(ledSelect7[digit], HIGH); // Light this LED
        delay(2);
        digitalWrite(ledSelect7[digit], LOW); // unLight this LED
    }
} // end of function
//} // end of C segment

#endif

